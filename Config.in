## Config.in
```kconfig
config BR2_PACKAGE_SGX545_CE
	bool "sgx545-ce (PowerVR SGX545 kernel driver)"
	depends on BR2_LINUX_KERNEL
	depends on BR2_i386
	help
	  PowerVR SGX545 kernel services for the Intel Atom CE5300 family,
	  as fitted to the Control4 EA-1 and EA-3.

	  Ported from the GPL DDK 1.7.862890 tree Intel published for
	  Cedarview, which uses the same SGX545 core. Builds in-tree as
	  obj-y, so it works with CONFIG_MODULES=n.

	  This is the kernel half only. 3D also needs the matching userspace
	  blobs and pvrsrvctl to upload the microkernel; see the repository
	  README.

	  https://github.com/openHC/sgx545-ce
```

## Kconfig
```kconfig
# SPDX-License-Identifier: GPL-2.0
config SGX545_CE
	tristate "PowerVR SGX545 (Intel CE5300 / Cedarview) kernel services"
	depends on X86 && DRM
	help
	  Kernel services (pvrsrvkm) for the Imagination PowerVR SGX545 GPU as
	  fitted to the Intel Atom CE5300/CE5310 — and to Cedarview (GMA
	  3600/3650), which carries the same core. Ported from Intel's GPL
	  DDK 1.7.862890.

	  This is the kernel half only. 3D additionally needs the matching
	  DDK 1.7 userspace (EGL/GLES blobs + pvrsrvctl, which uploads the
	  microkernel); the driver only has to accept that upload.

	  Say M to build pvrsrvkm as a loadable module (recommended — the DDK is
	  large and this keeps it out of the kernel image), or Y to build it in
	  (which also works with CONFIG_MODULES=n).

	  If unsure, say N.
```

## drm/powervr_sgx/Kconfig
```kconfig
# SPDX-License-Identifier: GPL-2.0-only
# Copyright © 2026 Joseph Telaak

config DRM_POWERVR_SGX
	tristate "PowerVR SGX5xx (SGX545: Intel CE5300, Cedarview)"
	depends on DRM && PCI && MMU && X86
	select DRM_EXEC
	select DRM_GEM_SHMEM_HELPER
	select DRM_GPUVM
	select DRM_SCHED
	select CRC32
	select FW_LOADER
	select WANT_DEV_COREDUMP
	help
	  Render-only DRM driver for PowerVR SGX5xx GPUs. It supports the
	  SGX545 of the Intel Atom CE5300 media processors, where the GPU is
	  its own PCI function (8086:089b), and of Cedarview (GMA3600/3650,
	  with DRM_POWERVR_SGX_GMA500). The GPU runs a microkernel loaded
	  with request_firmware().

	  Not compatible with the vendor services driver (SGX545_CE): bind one
	  or the other.

	  If M is selected the module will be called powervr_sgx.

config DRM_POWERVR_SGX_GMA500
	bool "Cedarview SGX545, behind gma500"
	depends on DRM_POWERVR_SGX && DRM_GMA500
	select AUXILIARY_BUS
	help
	  Bind to the SGX545 of the Atom D2000/N2000 (Cedarview) GPU. There
	  the SGX shares a PCI function with the display, which gma500
	  drives; gma500 publishes the SGX as an auxiliary device, hands it
	  the register mapping and forwards its interrupt.

	  Say Y if this kernel runs on a Cedarview machine.

config DRM_POWERVR_SGX_OF
	bool "SGX on device tree SoCs (TI OMAP3630 SGX530)"
	depends on DRM_POWERVR_SGX && OF
	help
	  Bind to an SGX described by the img,powervr-sgx device tree
	  binding. Only parts whose GPU node sits in a ti-sysc module, which
	  clocks and powers it, are handled: the OMAP3630's SGX530, which
	  can't run jobs yet.

	  Say N unless this kernel is for such an SoC.

config DRM_POWERVR_SGX_KUNIT_TEST
	tristate "KUnit tests for the PowerVR SGX5xx driver" if !KUNIT_ALL_TESTS
	depends on DRM_POWERVR_SGX && KUNIT
	select DRM_KUNIT_TEST_HELPERS
	default KUNIT_ALL_TESTS
	help
	  Unit tests of the driver's firmware file checks (a well-formed
	  image is accepted, and every malformed header, table and checksum
	  is refused) and of kernel-object teardown at unbind. The tests
	  need no GPU.

	  For developers; if unsure, say N.
```
